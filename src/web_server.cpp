// ============================================================
//  web_server.cpp  –  Async HTTP + WebSocket + All API routes
//  v2.0.0
// ============================================================
#include "web_server.h"
#include "ir_database.h"
#include "ir_transmitter.h"
#include "ir_receiver.h"
#include "wifi_manager.h"
#include "ota_manager.h"
#include "group_manager.h"
#include "scheduler.h"
#include <LittleFS.h>
#include <ArduinoJson.h>
#include "sd_manager.h"
#include "macro_manager.h"
#include "nfc_module.h"
#include "rfid_module.h"
#include "subghz_module.h"
#include "nrf24_module.h"
#include "system_module.h"
#include "audit_manager.h"   // Batch 1: Audit Trail
#include "watchdog_manager.h" // Ultra Pro Watchdog — status fields
#include <ctime>          // time(), localtime_r() for SD backup timestamps

WebUI webUI;

// ── Helpers ───────────────────────────────────────────────────
static void sendJson(AsyncWebServerRequest* req, int code, const String& json) {
    AsyncWebServerResponse* r = req->beginResponse(code, "application/json", json);
    r->addHeader("Access-Control-Allow-Origin", "*");
    req->send(r);
}

// Body accumulator (multi-chunk POST body support)
static String* getBodyBuf(AsyncWebServerRequest* req) {
    if (!req->_tempObject) {
        req->_tempObject = new String();
        req->onDisconnect([req]() {
            if (req->_tempObject) {
                delete reinterpret_cast<String*>(req->_tempObject);
                req->_tempObject = nullptr;
            }
        });
    }
    return reinterpret_cast<String*>(req->_tempObject);
}
static void freeBodyBuf(AsyncWebServerRequest* req) {
    if (req->_tempObject) {
        delete reinterpret_cast<String*>(req->_tempObject);
        req->_tempObject = nullptr;
    }
}

// Macro to register a chunked-body POST handler.
// ESPAsyncWebServer sets t=0 for Transfer-Encoding: chunked requests
// (total length unknown). The correct end-of-body signal is (i + l >= t && t > 0)
// OR the "final" convention used by ESPAsyncWebServer: when the library has
// received the last chunk it calls the body handler one final time with
// (index + len == total) only when total > 0. For chunked encoding it calls
// with index=0, len=fullBody, total=0 on the only/last call.
// Solution: fire handler when (t == 0 && i == 0) [chunked, single callback]
// OR when (t > 0 && i + l >= t) [content-length known, final chunk].
#define POST_BODY(path, handler) \
    _server.on(path, HTTP_POST, \
        [](AsyncWebServerRequest* req){}, \
        nullptr, \
        [this](AsyncWebServerRequest* req, uint8_t* d, size_t l, size_t i, size_t t) { \
            if (getBodyBuf(req)->length() + l > HTTP_MAX_BODY) { \
                freeBodyBuf(req); \
                sendJson(req, 413, "{\"error\":\"Request too large\"}"); return; \
            } \
            getBodyBuf(req)->concat((char*)d, l); \
            bool lastChunk = (t > 0) ? (i + l >= t) : (i == 0); \
            if (lastChunk) { \
                String* buf = getBodyBuf(req); \
                handler(req, (uint8_t*)buf->c_str(), buf->length()); \
                freeBodyBuf(req); \
            } \
        })

// ── Constructor / begin / loop ────────────────────────────────
WebUI::WebUI() : _server(HTTP_PORT), _ws(WS_PATH) {}

void WebUI::begin() {
    setupWebSocket();
    setupApiRoutes();
    setupGroupRoutes();
    setupSchedulerRoutes();
    setupWifiRoutes();
    setupOtaRoutes();
    setupGpioRoutes();
    setupMacroRoutes();    // v2.2.0 internal LittleFS macros
    setupSdRoutes();       // SD card API routes
    setupModuleRoutes();   // Tasks 7-11: NFC/RFID/SubGHz/NRF24/System
    setupRestApiV1Routes(); // Batch 1: REST API v1
    setupAuditRoutes();    // Batch 1: Audit Trail
    setupDebugRoutes();    // Batch 1: Debug Panel
    setupRuleRoutes();     // Batch 2: Rule/Automation Engine
    setupNotifyRoutes();   // Batch 2: Telegram + WhatsApp Notifications
    setupAuthRoutes();     // Batch 3: User Authentication
    setupCaptivePortal();  // Batch 3: Captive Portal (AP mode)
    setupOtaImprovedRoutes(); // Batch 3: OTA version check
    setupWatchdogRoutes(); // Batch 3: Self-Healing Watchdog
    setupLogRoutes();      // Batch 4: Log Rotation + CSV Export
    setupStaticRoutes();   // must be last — catch-all
    _server.begin();
    Serial.printf(DEBUG_TAG " HTTP server on port %d\n", HTTP_PORT);
}

void WebUI::loop() {
    _ws.cleanupClients(WS_MAX_CLIENTS);
    _flushWsQueue();
    loopCaptivePortal();  // Batch 3: process DNS for captive portal
}

void WebUI::_flushWsQueue() {
    // Drain one message per call to avoid blocking loop() for too long
    // when many messages are queued (e.g. burst of IR events).
    while (true) {
        String msg;
        {
            // Hold lock only long enough to move the front string out.
            // String move is O(1) — no heap alloc inside the critical section.
            portENTER_CRITICAL(&_wsMux);
            bool empty = _wsQueue.empty();
            if (!empty) {
                msg = std::move(_wsQueue.front());  // O(1) pointer swap, no malloc
                _wsQueue.pop();                     // pop after move (destructor is no-op)
            }
            portEXIT_CRITICAL(&_wsMux);
            if (empty) break;
        }
        _ws.textAll(msg);
    }
}

// Internal push helper with queue depth cap (prevents heap exhaustion under load).
// NOTE: String copy (heap alloc) happens BEFORE portENTER_CRITICAL.
//       Only the pointer-swap push() runs inside the spinlock.
void WebUI::_pushWsMessage(const String& msg) {
    // Pre-copy outside the lock so malloc never runs with interrupts disabled.
    String copy(msg);
    portENTER_CRITICAL(&_wsMux);
    // Cap at WS_QUEUE_MAX entries: drop oldest if full (ring-buffer behaviour).
    if (_wsQueue.size() >= WS_QUEUE_MAX) {
        _wsQueue.pop();   // String destructor runs inside lock but is just a free()
                          // of the *dropped* entry — acceptable one-time cost.
    }
    _wsQueue.push(std::move(copy));   // move: no malloc inside critical section
    portEXIT_CRITICAL(&_wsMux);
}

// ── WebSocket ─────────────────────────────────────────────────
void WebUI::setupWebSocket() {
    _ws.onEvent(onWsEvent);
    _server.addHandler(&_ws);
}

/*static*/
void WebUI::onWsEvent(AsyncWebSocket* server, AsyncWebSocketClient* client,
                      AwsEventType type, void* arg, uint8_t* data, size_t len)
{
    (void)server;
    switch (type) {
        case WS_EVT_CONNECT:
            Serial.printf(DEBUG_TAG " WS #%u connected\n", client->id());
            client->text("{\"event\":\"connected\",\"version\":\"" FIRMWARE_VERSION "\"}");
            break;
        case WS_EVT_DISCONNECT:
            Serial.printf(DEBUG_TAG " WS #%u disconnected\n", client->id());
            break;
        case WS_EVT_DATA: {
            AwsFrameInfo* fi = (AwsFrameInfo*)arg;
            if (fi->final && fi->index == 0 && fi->len == len && fi->opcode == WS_TEXT) {
                char buf[24] = {0};
                memcpy(buf, data, len < 23 ? len : 23);
                if (strcmp(buf, "ping") == 0)
                    client->text("{\"event\":\"pong\"}");
            }
            break;
        }
        case WS_EVT_ERROR:
            Serial.printf(DEBUG_TAG " WS #%u error\n", client->id());
            break;
        default: break;
    }
}

// ── Static / fallback routes ──────────────────────────────────
void WebUI::setupStaticRoutes() {
    // ── favicon — suppress "does not exist" log spam ──────────
    _server.on("/favicon.ico", HTTP_GET, [](AsyncWebServerRequest* req) {
        if (LittleFS.exists("/favicon.ico"))
            req->send(LittleFS, "/favicon.ico", "image/x-icon");
        else
            req->send(204);
    });



    // ── / and /index.html — serve gzip-compressed if available ──
    // index.html.gz is ~78% smaller (57KB vs 270KB), critical for LittleFS space.
    // All modern browsers support gzip Content-Encoding transparently.
    auto serveIndex = [](AsyncWebServerRequest* req) {
        if (LittleFS.exists("/index.html.gz")) {
            // Check if client accepts gzip (virtually all browsers do)
            String ae = req->header("Accept-Encoding");
            if (ae.indexOf("gzip") >= 0) {
                // Serve gzip-compressed file — browser decompresses transparently
                AsyncWebServerResponse* r = req->beginResponse(
                    LittleFS, "/index.html.gz", "text/html");
                r->addHeader("Content-Encoding", "gzip");
                r->addHeader("Vary", "Accept-Encoding");
                r->addHeader("Cache-Control", "no-store, no-cache, must-revalidate");
                r->addHeader("Pragma", "no-cache");
                req->send(r);
            } else {
                // Rare: client doesn't accept gzip — decompress in RAM and send
                // (only ~57KB to decompress; fits in ESP32 heap)
                File f = LittleFS.open("/index.html.gz", "r");
                if (f) {
                    // Can't decompress on ESP32 easily — redirect to fallback OTA page
                    f.close();
                }
                // Fallback: serve as-is with gzip header anyway
                // Modern ESP32 browsers always support gzip
                AsyncWebServerResponse* r = req->beginResponse(
                    LittleFS, "/index.html.gz", "text/html");
                r->addHeader("Content-Encoding", "gzip");
                r->addHeader("Cache-Control", "no-store, no-cache, must-revalidate");
                req->send(r);
            }
        } else if (LittleFS.exists("/index.html")) {
            AsyncWebServerResponse* r = req->beginResponse(
                LittleFS, "/index.html", "text/html");
            r->addHeader("Cache-Control", "no-store, no-cache, must-revalidate");
            r->addHeader("Pragma", "no-cache");
            req->send(r);
        } else {
            // Friendly OTA upload page — user can flash littlefs.bin
            // directly from the browser without USB/esptool.
            req->send(200, "text/html",
                "<!DOCTYPE html><html><head>"
                "<meta charset='UTF-8'/>"
                "<meta name='viewport' content='width=device-width,initial-scale=1'/>"
                "<title>IR Remote " FIRMWARE_VERSION " — Web UI Setup</title>"
                "<style>"
                "*{box-sizing:border-box;margin:0;padding:0}"
                "body{font-family:'Segoe UI',system-ui,sans-serif;background:#0f1117;"
                "color:#e8eaf6;min-height:100vh;display:flex;align-items:center;"
                "justify-content:center;padding:20px}"
                ".card{background:#1a1d27;border:1px solid #2e3148;border-radius:14px;"
                "padding:32px;max-width:520px;width:100%;box-shadow:0 8px 32px rgba(0,0,0,.5)}"
                "h1{font-size:1.3rem;margin-bottom:6px;color:#fff}"
                ".sub{font-size:.85rem;color:#8b92b8;margin-bottom:24px}"
                ".badge{display:inline-block;background:#6c63ff;color:#fff;border-radius:6px;"
                "padding:2px 10px;font-size:.75rem;font-weight:700;margin-bottom:18px}"
                ".drop{border:2px dashed #3d4266;border-radius:10px;padding:28px 20px;"
                "text-align:center;cursor:pointer;transition:all .2s;background:#0f1117;"
                "margin-bottom:14px}"
                ".drop:hover,.drop.over{border-color:#6c63ff;background:rgba(108,99,255,.06)}"
                ".drop-icon{font-size:2.2rem;margin-bottom:8px}"
                ".drop-label{color:#8b92b8;font-size:.9rem}"
                ".drop-file{color:#6c63ff;font-size:.82rem;margin-top:6px;font-family:monospace}"
                ".btn{display:inline-flex;align-items:center;gap:6px;padding:10px 22px;"
                "border-radius:8px;border:none;cursor:pointer;font-size:.9rem;font-weight:600;"
                "background:#6c63ff;color:#fff;transition:all .14s;width:100%;"
                "justify-content:center;margin-bottom:10px}"
                ".btn:disabled{opacity:.4;cursor:not-allowed}"
                ".btn:hover:not(:disabled){background:#4a43cc}"
                ".progress{display:none;margin-top:12px}"
                ".bar-wrap{background:#2e3148;border-radius:6px;height:10px;overflow:hidden;"
                "margin-bottom:6px}"
                ".bar{height:100%;background:#6c63ff;width:0%;transition:width .3s;border-radius:6px}"
                ".bar.done{background:#2ecc71}.bar.err{background:#e74c3c}"
                ".status{font-size:.82rem;color:#8b92b8;margin-top:4px}"
                ".status.ok{color:#2ecc71}.status.err{color:#e74c3c}"
                ".note{font-size:.78rem;color:#555c7a;margin-top:16px;line-height:1.6;"
                "border-top:1px solid #2e3148;padding-top:14px}"
                "a{color:#6c63ff;text-decoration:none}"
                "</style></head><body>"
                "<div class='card'>"
                "<div class='badge'>IR Remote v" FIRMWARE_VERSION "</div>"
                "<h1>&#128190; Flash Web UI</h1>"
                "<p class='sub'>Firmware is running. Upload <strong>littlefs.bin</strong>"
                " below to complete setup — no USB cable needed.</p>"
                "<div class='drop' id='drop' onclick=\"document.getElementById('f').click()\">"
                "<div class='drop-icon'>&#128193;</div>"
                "<div class='drop-label'>Click or drag <code>littlefs.bin</code> here</div>"
                "<div class='drop-file' id='fname'></div>"
                "</div>"
                "<input type='file' id='f' accept='.bin' style='display:none'"
                " onchange=\"onFile(this.files[0])\">"
                "<button class='btn' id='btn' onclick='doFlash()' disabled>"
                "&#9889; Flash Web UI</button>"
                "<div class='progress' id='prog'>"
                "<div class='bar-wrap'><div class='bar' id='bar'></div></div>"
                "<div class='status' id='stat'>Uploading&hellip;</div>"
                "</div>"
                "<div class='note'>"
                "&#9432; This page appears when the firmware has been updated but the "
                "Web UI package (LittleFS) has not yet been flashed.<br>"
                "All IR Remote features work via the API. "
                "<a href='/api/status'>Check system status</a>."
                "</div></div>"
                "<script>"
                "var file=null;"
                "function onFile(f){file=f;"
                "document.getElementById('fname').textContent=f.name+' ('+Math.round(f.size/1024)+'KB)';"
                "document.getElementById('btn').disabled=false;}"
                "var drop=document.getElementById('drop');"
                "drop.ondragover=function(e){e.preventDefault();drop.classList.add('over');};"
                "drop.ondragleave=function(){drop.classList.remove('over');};"
                "drop.ondrop=function(e){e.preventDefault();drop.classList.remove('over');"
                "onFile(e.dataTransfer.files[0]);};"
                "function doFlash(){"
                "if(!file)return;"
                "var btn=document.getElementById('btn'),prog=document.getElementById('prog'),"
                "bar=document.getElementById('bar'),stat=document.getElementById('stat');"
                "btn.disabled=true;prog.style.display='block';"
                "var fd=new FormData();fd.append('file',file,file.name);"
                "var xhr=new XMLHttpRequest();"
                "xhr.upload.onprogress=function(e){"
                "if(e.lengthComputable){var p=Math.round(e.loaded/e.total*90);"
                "bar.style.width=p+'%';"
                "stat.textContent='Uploading\u2026 '+Math.round(e.loaded/1024)+'KB / '+Math.round(e.total/1024)+'KB';}};"
                "xhr.onload=function(){"
                "bar.style.width='100%';"
                "try{var r=JSON.parse(xhr.responseText);"
                "if(r.ok){bar.classList.add('done');stat.className='status ok';"
                "stat.textContent='\u2713 Flashed! Rebooting\u2026';"
                "setTimeout(function(){window.location.reload();},6000);}"
                "else{bar.classList.add('err');stat.className='status err';"
                "stat.textContent='\u2717 Error: '+(r.error||r.note||'unknown');btn.disabled=false;}}"
                "catch(e){bar.classList.add('done');stat.className='status ok';"
                "stat.textContent='\u2713 Flashed! Rebooting\u2026';"
                "setTimeout(function(){window.location.reload();},6000);}"  
                "};"
                "xhr.onerror=function(){bar.classList.add('err');stat.className='status err';"
                "stat.textContent='Network error';btn.disabled=false;};"
                "xhr.open('POST','/api/ota/update?target=filesystem');"
                "xhr.send(fd);}"
                "</script></body></html>"
            );
        }
    };
    _server.on("/", HTTP_GET, serveIndex);
    _server.on("/index.html", HTTP_GET, serveIndex);
    _server.on("/index.htm",  HTTP_GET, serveIndex);

    // serveStatic for all other assets (css, js, images if any).
    // Does NOT handle "/" itself — our specific handler above takes priority.
    // setDefaultFile("index.html.gz") ensures any sub-path also serves the SPA.
    _server.serveStatic("/", LittleFS, "/")
           .setCacheControl("max-age=600")
           .setDefaultFile("index.html.gz");

    _server.onNotFound([](AsyncWebServerRequest* req) {
        if (req->method() == HTTP_OPTIONS) {
            AsyncWebServerResponse* r = req->beginResponse(204);
            r->addHeader("Access-Control-Allow-Origin",  "*");
            r->addHeader("Access-Control-Allow-Methods", "GET,POST,DELETE,OPTIONS");
            r->addHeader("Access-Control-Allow-Headers", "Content-Type");
            req->send(r); return;
        }
        // Suppress common browser auto-requests
        const String& url = req->url();
        if (url == "/favicon.ico" || url == "/robots.txt" ||
            url == "/apple-touch-icon.png") {
            req->send(204); return;
        }
        sendJson(req, 404, "{\"error\":\"Not found\"}");
    });
}
void WebUI::setupOtaRoutes() {
    // Clear OTA error state (allows retry without reboot)
    // Returns 409 if a restart is already pending — caller should not retry.
    _server.on("/api/ota/clear", HTTP_POST,
        [](AsyncWebServerRequest* req) {
            if (otaMgr.restartPending()) {
                sendJson(req, 409, "{\"ok\":false,\"note\":\"Reboot already pending — do not retry\"}");
                return;
            }
            otaMgr.clearError();
            sendJson(req, 200, "{\"ok\":true,\"note\":\"OTA error cleared\"}");
        });

    _server.on("/api/ota/update", HTTP_POST,
        [](AsyncWebServerRequest* req) {
            // FIX: Check restartPending FIRST — it is set only by finishUpdate()
            // which means Update.end() succeeded and the image was committed.
            // Checking lastError alone was insufficient: if Update.end() failed
            // silently, lastError would be empty but restartPending = false,
            // and we'd incorrectly send ok:true "Rebooting".
            if (otaMgr.isUpdating()) {
                sendJson(req, 503, "{\"error\":\"Update already in progress\"}"); return;
            }
            if (otaMgr.lastError().length() > 0) {
                String e = otaMgr.lastError(); e.replace("\"","'");
                sendJson(req, 200, String("{\"ok\":false,\"error\":\"") + e + "\"}");
            } else if (otaMgr.restartPending()) {
                sendJson(req, 200, "{\"ok\":true,\"note\":\"Rebooting\"}");
            } else {
                // Upload handler not yet called OR update abandoned silently
                sendJson(req, 200, "{\"ok\":true,\"note\":\"Upload received\"}");
            }
        },
        [this](AsyncWebServerRequest* req, const String& filename,
               size_t index, uint8_t* data, size_t len, bool final) {
            // ESPAsyncWebServer upload callback: index, data, len, final
            // total is carried via Content-Length header when available
            size_t total = 0;
            const AsyncWebHeader* clHdr = req->getHeader("Content-Length");
            if (clHdr) {
                long clVal = clHdr->value().toInt();
                if (clVal > 0) total = (size_t)clVal;
            }
            handleOtaUpload(req, filename, index, data, len, total, final);
        });
}

void WebUI::handleOtaUpload(AsyncWebServerRequest* req, const String& filename,
                             size_t index, uint8_t* data, size_t len,
                             size_t total, bool final)
{
    String target = "firmware";
    if (req->hasParam("target")) target = req->getParam("target")->value();
    else if (filename.indexOf("littlefs") >= 0 || filename.indexOf("spiffs") >= 0)
        target = "filesystem";
    otaMgr.handleUploadChunk(target, data, len, index, total, final);
}

// ── GPIO routes ───────────────────────────────────────────────
void WebUI::setupGpioRoutes() {
    _server.on("/api/gpio/pins", HTTP_GET,
        [this](AsyncWebServerRequest* req) { handleGetGpioPins(req); });

    POST_BODY("/api/gpio/pins",
        [this](AsyncWebServerRequest* req, uint8_t* d, size_t l) {
            handleSetGpioPins(req, d, l);
        });

    _server.on("/api/gpio/available", HTTP_GET,
        [this](AsyncWebServerRequest* req) { handleGetPinList(req); });
}

// ── Core API routes ───────────────────────────────────────────
void WebUI::setupApiRoutes() {
    _server.on("/api/buttons", HTTP_GET,
        [this](AsyncWebServerRequest* req) { handleGetButtons(req); });

    POST_BODY("/api/buttons",
        ([this](AsyncWebServerRequest* req, uint8_t* d, size_t l){
            handleAddButton(req, d, l); }));

    POST_BODY("/api/buttons/update",
        ([this](AsyncWebServerRequest* req, uint8_t* d, size_t l){
            handleUpdateButton(req, d, l); }));

    _server.on("/api/buttons/delete", HTTP_GET,
        [this](AsyncWebServerRequest* req) { handleDeleteButton(req); });

    _server.on("/api/clear", HTTP_POST,
        [this](AsyncWebServerRequest* req) { handleClearButtons(req); });

    POST_BODY("/api/transmit",
        ([this](AsyncWebServerRequest* req, uint8_t* d, size_t l){
            handleTransmit(req, d, l); }));

    // POST /api/v1/ir/pwm-test
    // Send a test RAW burst at a specified carrier frequency to verify
    // the emitter and PWM output are working correctly.
    // Body: { "freqKHz": 38, "emitterIdx": 0 }
    // Response: { "ok": true, "freqKHz": 38, "pulsesUs": [9000,4500,...] }
    POST_BODY("/api/v1/ir/pwm-test",
        ([this](AsyncWebServerRequest* req, uint8_t* d, size_t l){
            handlePwmTest(req, d, l); }));

    // GET /api/v1/ir/pwm-info
    // Returns PWM capabilities: valid freq range, default, current emitter pins.
    _server.on("/api/v1/ir/pwm-info", HTTP_GET,
        [this](AsyncWebServerRequest* req) { handlePwmInfo(req); });

    _server.on("/api/export", HTTP_GET,
        [this](AsyncWebServerRequest* req) { handleExport(req); });

    POST_BODY("/api/import",
        ([this](AsyncWebServerRequest* req, uint8_t* d, size_t l){
            handleImport(req, d, l); }));

    _server.on("/api/config", HTTP_GET,
        [this](AsyncWebServerRequest* req) { handleGetConfig(req); });

    POST_BODY("/api/config",
        ([this](AsyncWebServerRequest* req, uint8_t* d, size_t l){
            handleSetConfig(req, d, l); }));

    // GET /api/ping — dead-simple connectivity check, no auth/LittleFS needed
    _server.on("/api/ping", HTTP_GET, [](AsyncWebServerRequest* req) {
        String body = String("{\"ok\":true,\"firmware\":\"")
                    + FIRMWARE_VERSION
                    + "\",\"heap\":"
                    + String(ESP.getFreeHeap()) + "}";
        AsyncWebServerResponse* r = req->beginResponse(200, "application/json", body);
        r->addHeader("Access-Control-Allow-Origin", "*");
        req->send(r);
    });

    _server.on("/api/status", HTTP_GET,
        [this](AsyncWebServerRequest* req) { handleGetStatus(req); });

    _server.on("/api/restart", HTTP_POST,
        [this](AsyncWebServerRequest* req) { handleRestart(req); });

    // Fix 1: auto-save config routes
    _server.on("/api/autosave", HTTP_GET,
        [this](AsyncWebServerRequest* req) { handleGetAutoSave(req); });
    _server.on("/api/autosave", HTTP_POST,
        [this](AsyncWebServerRequest* req) { handleSetAutoSave(req); });

    // ── Backup & Restore routes ───────────────────────────────
    // POST /api/backup          → create backup of current DB
    // GET  /api/backup          → download the backup file
    // GET  /api/backup/status   → check if backup exists + metadata
    // POST /api/restore         → upload JSON, validate, backup, restore
    _server.on("/api/backup", HTTP_POST,
        [this](AsyncWebServerRequest* req) { handleBackupCreate(req); });

    _server.on("/api/backup", HTTP_GET,
        [this](AsyncWebServerRequest* req) { handleBackupDownload(req); });

    _server.on("/api/backup/status", HTTP_GET,
        [this](AsyncWebServerRequest* req) { handleBackupStatus(req); });

    POST_BODY("/api/restore",
        ([this](AsyncWebServerRequest* req, uint8_t* d, size_t l){
            handleRestore(req, d, l); }));
}

// ── Group routes ──────────────────────────────────────────────
void WebUI::setupGroupRoutes() {
    _server.on("/api/groups", HTTP_GET,
        [this](AsyncWebServerRequest* req) { handleGetGroups(req); });

    POST_BODY("/api/groups",
        ([this](AsyncWebServerRequest* req, uint8_t* d, size_t l){
            handleAddGroup(req, d, l); }));

    POST_BODY("/api/groups/update",
        ([this](AsyncWebServerRequest* req, uint8_t* d, size_t l){
            handleUpdateGroup(req, d, l); }));

    _server.on("/api/groups/delete", HTTP_GET,
        [this](AsyncWebServerRequest* req) { handleDeleteGroup(req); });

    POST_BODY("/api/groups/reorder",
        ([this](AsyncWebServerRequest* req, uint8_t* d, size_t l){
            handleReorderGroup(req, d, l); }));
}

// ── Scheduler routes ──────────────────────────────────────────
void WebUI::setupSchedulerRoutes() {
    _server.on("/api/schedules", HTTP_GET,
        [this](AsyncWebServerRequest* req) { handleGetSchedules(req); });

    POST_BODY("/api/schedules",
        ([this](AsyncWebServerRequest* req, uint8_t* d, size_t l){
            handleAddSchedule(req, d, l); }));

    POST_BODY("/api/schedules/update",
        ([this](AsyncWebServerRequest* req, uint8_t* d, size_t l){
            handleUpdateSchedule(req, d, l); }));

    _server.on("/api/schedules/delete", HTTP_GET,
        [this](AsyncWebServerRequest* req) { handleDeleteSchedule(req); });

    POST_BODY("/api/schedules/toggle",
        ([this](AsyncWebServerRequest* req, uint8_t* d, size_t l){
            handleToggleSchedule(req, d, l); }));

    _server.on("/api/ntp/status", HTTP_GET,
        [this](AsyncWebServerRequest* req) { handleGetNtpStatus(req); });

    POST_BODY("/api/ntp/timezone",
        ([this](AsyncWebServerRequest* req, uint8_t* d, size_t l){
            handleSetTimezone(req, d, l); }));
}

// ── Wi-Fi scan routes ─────────────────────────────────────────
void WebUI::setupWifiRoutes() {
    _server.on("/api/wifi/scan", HTTP_POST,
        [this](AsyncWebServerRequest* req) { handleStartScan(req); });

    _server.on("/api/wifi/scan", HTTP_GET,
        [this](AsyncWebServerRequest* req) { handleScanResults(req); });
}

// ─────────────────────────────────────────────────────────────
//  Handler implementations
// ─────────────────────────────────────────────────────────────

// ── Buttons ───────────────────────────────────────────────────
void WebUI::handleGetButtons(AsyncWebServerRequest* req) {
    sendJson(req, 200, irDB.compactJson());
}

void WebUI::handleAddButton(AsyncWebServerRequest* req, uint8_t* d, size_t l) {
    JsonDocument doc;
    if (deserializeJson(doc, d, l) != DeserializationError::Ok)
        { sendJson(req,400,"{\"error\":\"JSON parse failed\"}"); return; }
    IRButton btn;
    if (!btn.fromJson(doc.as<JsonObjectConst>()))
        { sendJson(req,400,"{\"error\":\"Invalid button data\"}"); return; }
    // Apply protocol repeat defaults if not supplied
    if (!doc["repeatCount"].is<int>()) {
        auto preset = defaultRepeatForProtocol(btn.protocol);
        btn.repeatCount = preset.count;
        btn.repeatDelay = preset.delayMs;
    }
    uint32_t id = irDB.add(btn);
    if (!id) { sendJson(req,500,"{\"error\":\"DB full\"}"); return; }
    JsonDocument r; r["ok"]=true; r["id"]=id;
    String out; serializeJson(r,out);
    sendJson(req,200,out);
}

void WebUI::handleUpdateButton(AsyncWebServerRequest* req, uint8_t* d, size_t l) {
    JsonDocument doc;
    if (deserializeJson(doc,d,l)!=DeserializationError::Ok)
        { sendJson(req,400,"{\"error\":\"JSON parse failed\"}"); return; }
    IRButton btn;
    if (!btn.fromJson(doc.as<JsonObjectConst>()) || !btn.id)
        { sendJson(req,400,"{\"error\":\"Invalid data\"}"); return; }
    if (!irDB.update(btn.id,btn))
        { sendJson(req,404,"{\"error\":\"Not found\"}"); return; }
    sendJson(req,200,"{\"ok\":true}");
}

void WebUI::handleClearButtons(AsyncWebServerRequest* req) {
    irDB.clear();
    JsonDocument r; r["ok"]=true; r["buttons"]=0;
    String out; serializeJson(r,out); sendJson(req,200,out);
}

void WebUI::handleDeleteButton(AsyncWebServerRequest* req) {
    if (!req->hasParam("id"))
        { sendJson(req,400,"{\"error\":\"Missing id\"}"); return; }
    int raw = req->getParam("id")->value().toInt();
    if (raw<=0) { sendJson(req,400,"{\"error\":\"Invalid id\"}"); return; }
    if (!irDB.remove((uint32_t)raw))
        { sendJson(req,404,"{\"error\":\"Not found\"}"); return; }
    sendJson(req,200,"{\"ok\":true}");
}

void WebUI::handleTransmit(AsyncWebServerRequest* req, uint8_t* d, size_t l) {
    JsonDocument doc;
    if (deserializeJson(doc,d,l)!=DeserializationError::Ok)
        { sendJson(req,400,"{\"error\":\"JSON parse failed\"}"); return; }
    bool ok = false;
    if (doc["id"].is<int>() && doc["id"].as<int>()>0) {
        uint32_t id = doc["id"].as<uint32_t>();
        IRButton copy = irDB.findById(id);
        if (!copy.id) { sendJson(req,404,"{\"error\":\"Not found\"}"); return; }
        // Override repeat if specified in request
        if (doc["repeatCount"].is<int>()) copy.repeatCount = doc["repeatCount"].as<uint8_t>();
        if (doc["repeatDelay"].is<int>()) copy.repeatDelay = doc["repeatDelay"].as<uint16_t>();
        if (doc["emitterIdx"].is<int>()) {
            ok = irTransmitter.transmitOn(doc["emitterIdx"].as<uint8_t>(), copy);
        } else {
            ok = irTransmitter.transmit(copy);
        }
    } else {
        IRButton btn;
        if (!doc["name"].is<const char*>()) doc["name"] = "_tx_test";
        if (!btn.fromJson(doc.as<JsonObjectConst>()))
            { sendJson(req,400,"{\"error\":\"Invalid data\"}"); return; }
        ok = irTransmitter.transmit(btn);
    }
    sendJson(req, ok?200:500, ok?"{\"ok\":true}":"{\"error\":\"Transmit failed\"}");
}

// ── PWM / carrier frequency test ─────────────────────────────
// Sends a standard NEC-style mark/space RAW pattern at the requested
// carrier frequency. This verifies:
//   1. The IR emitter LED is wired correctly
//   2. The ledc PWM timer generates the right carrier
//   3. The freqKHz field in saved buttons will transmit correctly
//
// Standard test pattern: 9 ms mark + 4.5 ms space + 560 us mark (AGC burst).
// A receiver / oscilloscope on the RX pin will show the modulated carrier.
void WebUI::handlePwmTest(AsyncWebServerRequest* req, uint8_t* d, size_t l) {
    JsonDocument doc;
    if (deserializeJson(doc, d, l) != DeserializationError::Ok) {
        sendJson(req, 400, "{"error":"JSON parse failed"}"); return;
    }

    uint16_t freqKHz = doc["freqKHz"] | (uint16_t)IR_DEFAULT_FREQ_KHZ;
    // Clamp to valid range
    if (freqKHz < 20 || freqKHz > 60) freqKHz = IR_DEFAULT_FREQ_KHZ;

    uint8_t emitterIdx = doc["emitterIdx"] | (uint8_t)0;

    // Build a minimal AGC preamble RAW pattern (NEC-style mark+space+mark).
    // Times in microseconds: 9000 mark, 4500 space, 560 mark.
    // This is short enough to complete well within any WDT timeout.
    static const uint16_t testPulses[] = { 9000, 4500, 560 };
    const size_t numPulses = sizeof(testPulses) / sizeof(testPulses[0]);

    bool ok = irTransmitter.transmitRaw(testPulses, numPulses, freqKHz);

    // Build response with echo of what was sent
    JsonDocument resp;
    resp["ok"]       = ok;
    resp["freqKHz"]  = freqKHz;
    resp["freqHz"]   = (uint32_t)(freqKHz * 1000);
    JsonArray pulses = resp["pulsesUs"].to<JsonArray>();
    for (size_t i = 0; i < numPulses; i++) pulses.add(testPulses[i]);
    resp["note"] = ok
        ? String("AGC burst sent at ") + freqKHz + " kHz on emitter " + emitterIdx
        : "Transmit failed — check emitter GPIO";
    String out; serializeJson(resp, out);
    sendJson(req, ok ? 200 : 500, out);
}

// ── PWM capabilities info ─────────────────────────────────────
// Returns valid carrier frequency range and current emitter config.
// UI uses this to build the frequency selector with correct bounds.
void WebUI::handlePwmInfo(AsyncWebServerRequest* req) {
    JsonDocument doc;
    doc["freqKhzDefault"] = (uint16_t)IR_DEFAULT_FREQ_KHZ;
    doc["freqKhzMin"]     = 20;    // hardware minimum for ESP32 ledc @ IR timings
    doc["freqKhzMax"]     = 60;    // hardware maximum useful for IR
    doc["freqKhzCommon"]  = "36, 38 (standard), 40, 56";
    doc["pwmResolutionBits"] = 8;  // ESP32 ledc resolution used by IRremoteESP8266
    doc["pwmDriverNote"]  = "ESP32 hardware ledc — no CPU bitbanging";

    // List active emitter GPIOs and their current state
    JsonArray emitters = doc["emitters"].to<JsonArray>();
    auto pins = irTransmitter.activePins();
    for (size_t i = 0; i < pins.size(); i++) {
        JsonObject e = emitters.add<JsonObject>();
        e["idx"]    = (int)i;
        e["gpio"]   = pins[i];
        e["active"] = true;
    }
    doc["emitterCount"] = (int)pins.size();
    String out; serializeJson(doc, out);
    sendJson(req, 200, out);
}

void WebUI::handleExport(AsyncWebServerRequest* req) {
    String json = irDB.exportJson();
    AsyncWebServerResponse* r = req->beginResponse(200,"application/json",json);
    r->addHeader("Content-Disposition","attachment; filename=\"ir_database.json\"");
    r->addHeader("Access-Control-Allow-Origin","*");
    req->send(r);
}

void WebUI::handleImport(AsyncWebServerRequest* req, uint8_t* d, size_t l) {
    String json((char*)d,l);
    if (!irDB.importJson(json))
        { sendJson(req,400,"{\"error\":\"Import failed\"}"); return; }
    JsonDocument r; r["ok"]=true; r["buttons"]=(int)irDB.size();
    String out; serializeJson(r,out); sendJson(req,200,out);
}

void WebUI::handleGetConfig(AsyncWebServerRequest* req) {
    const WiFiConfig& cfg = wifiMgr.config();
    JsonDocument doc;
    doc["apSSID"]    = cfg.apSSID;
    doc["apPass"]    = cfg.apPass;
    doc["apChannel"] = cfg.apChannel;
    doc["apHidden"]  = cfg.apHidden;
    doc["staSSID"]   = cfg.staSSID;
    doc["staPass"]   = cfg.staPass;
    doc["staEnabled"]= cfg.staEnabled;
    String out; serializeJson(doc,out);
    sendJson(req,200,out);
}

void WebUI::handleSetConfig(AsyncWebServerRequest* req, uint8_t* d, size_t l) {
    JsonDocument doc;
    if (deserializeJson(doc,d,l)!=DeserializationError::Ok)
        { sendJson(req,400,"{\"error\":\"JSON parse failed\"}"); return; }
    WiFiConfig& cfg = wifiMgr.config();
    if (doc["apSSID"].is<const char*>())   cfg.apSSID     = doc["apSSID"].as<String>();
    if (doc["apPass"].is<const char*>())   cfg.apPass     = doc["apPass"].as<String>();
    if (doc["apChannel"].is<int>()) {
        int ch = doc["apChannel"].as<int>();
        cfg.apChannel = (ch>=1 && ch<=13) ? (uint8_t)ch : 1;
    }
    if (doc["apHidden"].is<bool>())        cfg.apHidden   = doc["apHidden"].as<bool>();
    if (doc["staSSID"].is<const char*>())  cfg.staSSID    = doc["staSSID"].as<String>();
    if (doc["staPass"].is<const char*>())  cfg.staPass    = doc["staPass"].as<String>();
    if (doc["staEnabled"].is<bool>())      cfg.staEnabled = doc["staEnabled"].as<bool>();

    if (!wifiMgr.saveConfig())
        { sendJson(req,500,"{\"error\":\"Flash write failed\"}"); return; }

    // Apply STA changes immediately; AP changes need a restart
    bool staChanged = doc["staSSID"].is<const char*>() || doc["staEnabled"].is<bool>() || doc["staPass"].is<const char*>();
    if (staChanged) {
        wifiMgr.applyStaConfig();
        sendJson(req,200,"{\"ok\":true,\"note\":\"STA reconnecting — AP stays up\"}");
    } else {
        sendJson(req,200,"{\"ok\":true,\"note\":\"AP settings saved — restart to apply\"}");
    }
}

void WebUI::handleGetStatus(AsyncWebServerRequest* req) {
    JsonDocument doc;
    // RAM
    doc["freeHeap"]      = ESP.getFreeHeap();
    doc["totalHeap"]     = ESP.getHeapSize();
    doc["minFreeHeap"]   = ESP.getMinFreeHeap();
    // Flash / LittleFS — guard: filesystem may be unmounted during OTA
    doc["flashSize"]     = (uint32_t)(ESP.getFlashChipSize() / 1024);       // KB
    doc["fsTotal"]       = otaMgr.isUpdating() ? 0 : (uint32_t)(LittleFS.totalBytes() / 1024);
    doc["fsUsed"]        = otaMgr.isUpdating() ? 0 : (uint32_t)(LittleFS.usedBytes()  / 1024);
    // CPU
    doc["cpuFreqMHz"]    = ESP.getCpuFreqMHz();
    // Wi-Fi
    doc["apIP"]          = wifiMgr.apIP();
    doc["apActive"]      = wifiMgr.apActive();
    doc["staIP"]         = wifiMgr.staIP();
    doc["staConnected"]  = wifiMgr.staConnected();
    doc["staRSSI"]       = wifiMgr.staRSSI();
    doc["staSSID"]       = wifiMgr.staSSID();
    doc["staStatus"]     = wifiMgr.staStatus();
    doc["apClients"]     = (int)WiFi.softAPgetStationNum();
    // System
    doc["uptime"]        = (uint32_t)(millis() / 1000);
    doc["firmware"]      = FIRMWARE_VERSION;
    doc["chip"]          = ESP.getChipModel();
    doc["chipRev"]       = (int)ESP.getChipRevision();
    // IR
    doc["buttons"]       = (int)irDB.size();
    doc["groups"]        = (int)groupMgr.size();
    doc["schedules"]     = (int)scheduler.size();
    doc["recvPin"]       = irReceiver.activePin();
    doc["emitters"]      = irTransmitter.activeCount();
    // NTP
    doc["ntpSynced"]     = scheduler.ntpSynced();
    doc["currentTime"]   = scheduler.ntpSynced() ? scheduler.currentTimeStr() : "N/A";
    doc["currentDate"]   = scheduler.ntpSynced() ? scheduler.currentDateStr() : "N/A";
    // Fix 1 + Fix 3: auto-save state and RAW count
    doc["autoSave"]      = irDB.autoSaveEnabled();
    doc["rawButtons"]    = (int)irDB.rawCount();
    doc["maxRawButtons"] = MAX_RAW_BUTTONS;
    // SD card status
    doc["sdMounted"]     = sdMgr.isAvailable();
    if (sdMgr.isAvailable()) {
        SdStatus ss = sdMgr.status();
        doc["sdCardType"]  = ss.cardTypeStr;
        doc["sdTotalKB"]   = (uint32_t)(ss.totalBytes / 1024);
        doc["sdUsedKB"]    = (uint32_t)(ss.usedBytes  / 1024);
        doc["sdMacro"]     = sdMgr.isMacroRunning();
    }
    // Internal macro status (v2.2.0)
    doc["macroRunning"]  = macroMgr.isRunning();
    doc["macroName"]     = macroMgr.runningName();
    doc["macroCount"]    = (int)macroMgr.list().size();
    // OTA flash space (real partition data)
    doc["otaPartKB"]     = (uint32_t)(otaMgr.otaPartitionSize() / 1024);  // real IDF partition size
    doc["otaFreeKB"]     = (uint32_t)(otaMgr.freeOtaBytes() / 1024);       // 0 = no valid OTA partition
    doc["otaPartOk"]     = (otaMgr.freeOtaBytes() > 0);                     // false = OTA impossible
    doc["sketchSizeKB"]  = (uint32_t)(ESP.getSketchSize() / 1024);
    doc["otaMaxKB"]      = (uint32_t)(OTA_MAX_FIRMWARE_BYTES / 1024);
    doc["fsFreeKB"]      = (uint32_t)(otaMgr.fsFreeBytes() / 1024);
    // Watchdog / system health (real sensor readings)
    doc["cpuTempC"]      = (float)((int)(wdtMgr.cpuTemperature() * 10)) / 10.0f;
    doc["heapMin"]       = wdtMgr.minHeapSeen();
    doc["internetOk"]    = wdtMgr.internetReachable();
    doc["safeMode"]      = wdtMgr.isSafeMode();
    doc["bootFailCount"] = (int)wdtMgr.bootFailCount();
    doc["perfMode"]      = wdtMgr.perfModeStr();

    String out; serializeJson(doc,out);
    sendJson(req,200,out);
}

void WebUI::handleRestart(AsyncWebServerRequest* req) {
    sendJson(req, 200, "{\"ok\":true}");
    // FIX: protect s_restartAt write with spinlock (same mux as main.cpp)
    extern portMUX_TYPE s_restartMux;
    extern volatile uint32_t s_restartAt;
    taskENTER_CRITICAL(&s_restartMux);
    s_restartAt = (uint32_t)(millis() + 400);
    taskEXIT_CRITICAL(&s_restartMux);
}

// ── Groups ────────────────────────────────────────────────────
void WebUI::handleGetGroups(AsyncWebServerRequest* req) {
    sendJson(req, 200, groupMgr.toJson());
}

void WebUI::handleAddGroup(AsyncWebServerRequest* req, uint8_t* d, size_t l) {
    JsonDocument doc;
    if (deserializeJson(doc,d,l)!=DeserializationError::Ok)
        { sendJson(req,400,"{\"error\":\"JSON parse failed\"}"); return; }
    String name = doc["name"] | (const char*)"";
    String icon = doc["icon"] | (const char*)"📺";
    uint32_t id = groupMgr.add(name, icon);
    if (!id) { sendJson(req,400,"{\"error\":\"Invalid name or group limit reached\"}"); return; }
    JsonDocument r; r["ok"]=true; r["id"]=id;
    String out; serializeJson(r,out); sendJson(req,200,out);
}

void WebUI::handleUpdateGroup(AsyncWebServerRequest* req, uint8_t* d, size_t l) {
    JsonDocument doc;
    if (deserializeJson(doc,d,l)!=DeserializationError::Ok)
        { sendJson(req,400,"{\"error\":\"JSON parse failed\"}"); return; }
    uint32_t id = doc["id"] | (uint32_t)0;
    String name = doc["name"] | (const char*)"";
    String icon = doc["icon"] | (const char*)"📺";
    if (!id || !groupMgr.update(id, name, icon))
        { sendJson(req,404,"{\"error\":\"Not found\"}"); return; }
    sendJson(req,200,"{\"ok\":true}");
}

void WebUI::handleDeleteGroup(AsyncWebServerRequest* req) {
    if (!req->hasParam("id"))
        { sendJson(req,400,"{\"error\":\"Missing id\"}"); return; }
    uint32_t id = (uint32_t)req->getParam("id")->value().toInt();
    if (!groupMgr.remove(id))
        { sendJson(req,400,"{\"error\":\"Cannot remove last group or not found\"}"); return; }

    // Reassign buttons in the deleted group to ungrouped (groupId=0).
    // Use compactJson snapshot to avoid holding a raw reference to the
    // internal vector across irDB.update() calls (which can reallocate it).
    std::vector<uint32_t> toFix;
    {
        // Collect IDs via findById-safe iteration: take a snapshot first.
        // irDB.buttons() returns a const ref — safe to read here since all
        // DB mutations happen on the same async-TCP task, but we still
        // collect IDs before calling update() to avoid iterator invalidation.
        const auto& all = irDB.buttons();
        for (const auto& b : all)
            if (b.groupId == id) toFix.push_back(b.id);
    }
    for (uint32_t bid : toFix) {
        IRButton copy = irDB.findById(bid);
        if (copy.id) { copy.groupId = 0; irDB.update(copy.id, copy); }
    }
    if (!toFix.empty())
        Serial.printf(DEBUG_TAG " Group %u deleted: %u button(s) ungrouped\n",
                      id, (unsigned)toFix.size());

    sendJson(req,200,"{\"ok\":true}");
}

void WebUI::handleReorderGroup(AsyncWebServerRequest* req, uint8_t* d, size_t l) {
    JsonDocument doc;
    if (deserializeJson(doc,d,l)!=DeserializationError::Ok)
        { sendJson(req,400,"{\"error\":\"JSON parse failed\"}"); return; }
    uint32_t id  = doc["id"]    | (uint32_t)0;
    uint8_t  ord = doc["order"] | (uint8_t)0;
    if (!groupMgr.reorder(id, ord))
        { sendJson(req,404,"{\"error\":\"Not found\"}"); return; }
    sendJson(req,200,"{\"ok\":true}");
}

// ── Scheduler ────────────────────────────────────────────────
void WebUI::handleGetSchedules(AsyncWebServerRequest* req) {
    sendJson(req, 200, scheduler.toJson());
}

void WebUI::handleAddSchedule(AsyncWebServerRequest* req, uint8_t* d, size_t l) {
    JsonDocument doc;
    if (deserializeJson(doc,d,l)!=DeserializationError::Ok)
        { sendJson(req,400,"{\"error\":\"JSON parse failed\"}"); return; }
    ScheduleEntry e;
    if (!e.fromJson(doc.as<JsonObjectConst>()))
        { sendJson(req,400,"{\"error\":\"Invalid schedule (buttonId required)\"}"); return; }
    uint32_t id = scheduler.addEntry(e);
    if (!id) { sendJson(req,400,"{\"error\":\"Schedule limit reached\"}"); return; }
    JsonDocument r; r["ok"]=true; r["id"]=id;
    String out; serializeJson(r,out); sendJson(req,200,out);
}

void WebUI::handleUpdateSchedule(AsyncWebServerRequest* req, uint8_t* d, size_t l) {
    JsonDocument doc;
    if (deserializeJson(doc,d,l)!=DeserializationError::Ok)
        { sendJson(req,400,"{\"error\":\"JSON parse failed\"}"); return; }
    ScheduleEntry e;
    if (!e.fromJson(doc.as<JsonObjectConst>()) || !e.id)
        { sendJson(req,400,"{\"error\":\"Invalid data\"}"); return; }
    if (!scheduler.updateEntry(e))
        { sendJson(req,404,"{\"error\":\"Not found\"}"); return; }
    sendJson(req,200,"{\"ok\":true}");
}

void WebUI::handleDeleteSchedule(AsyncWebServerRequest* req) {
    if (!req->hasParam("id"))
        { sendJson(req,400,"{\"error\":\"Missing id\"}"); return; }
    uint32_t id = (uint32_t)req->getParam("id")->value().toInt();
    if (!scheduler.removeEntry(id))
        { sendJson(req,404,"{\"error\":\"Not found\"}"); return; }
    sendJson(req,200,"{\"ok\":true}");
}

void WebUI::handleToggleSchedule(AsyncWebServerRequest* req, uint8_t* d, size_t l) {
    JsonDocument doc;
    if (deserializeJson(doc,d,l)!=DeserializationError::Ok)
        { sendJson(req,400,"{\"error\":\"JSON parse failed\"}"); return; }
    uint32_t id  = doc["id"]      | (uint32_t)0;
    bool     en  = doc["enabled"] | true;
    if (!scheduler.setEnabled(id, en))
        { sendJson(req,404,"{\"error\":\"Not found\"}"); return; }
    sendJson(req,200,"{\"ok\":true}");
}

void WebUI::handleGetNtpStatus(AsyncWebServerRequest* req) {
    JsonDocument doc;
    doc["synced"]   = scheduler.ntpSynced();
    doc["time"]     = scheduler.ntpSynced() ? scheduler.currentTimeStr() : "";
    doc["date"]     = scheduler.ntpSynced() ? scheduler.currentDateStr() : "";
    doc["tzOffset"] = scheduler.tzOffsetSec();
    doc["dstOffset"]= scheduler.dstOffsetSec();
    String out; serializeJson(doc,out); sendJson(req,200,out);
}

void WebUI::handleSetTimezone(AsyncWebServerRequest* req, uint8_t* d, size_t l) {
    JsonDocument doc;
    if (deserializeJson(doc,d,l)!=DeserializationError::Ok)
        { sendJson(req,400,"{\"error\":\"JSON parse failed\"}"); return; }
    long tz  = doc["tzOffset"]  | 0L;
    long dst = doc["dstOffset"] | 0L;
    scheduler.setTimezone(tz, dst);
    sendJson(req,200,"{\"ok\":true}");
}

// ── Wi-Fi scan ────────────────────────────────────────────────
void WebUI::handleStartScan(AsyncWebServerRequest* req) {
    wifiMgr.startScan();
    sendJson(req,200,"{\"ok\":true,\"note\":\"Scan started\"}");
}

void WebUI::handleScanResults(AsyncWebServerRequest* req) {
    sendJson(req,200, wifiMgr.scanResultsJson());
}

// ── Fix 1: Auto-save handlers ────────────────────────────────
void WebUI::handleGetAutoSave(AsyncWebServerRequest* req) {
    JsonDocument doc;
    doc["autoSave"]      = irDB.autoSaveEnabled();
    doc["rawButtons"]    = (int)irDB.rawCount();
    doc["maxRawButtons"] = MAX_RAW_BUTTONS;
    doc["lazyDelayMs"]   = (uint32_t)DB_LAZY_SAVE_MS;
    doc["dirty"]         = irDB.isDirty();
    String out; serializeJson(doc, out);
    sendJson(req, 200, out);
}

void WebUI::handleSetAutoSave(AsyncWebServerRequest* req) {
    if (!req->hasParam("enabled")) {
        sendJson(req, 400, "{\"error\":\"Missing 'enabled' param — use ?enabled=true or ?enabled=false\"}");
        return;
    }
    String val = req->getParam("enabled")->value();
    bool en = (val == "1" || val == "true");
    irDB.setAutoSave(en);
    JsonDocument doc;
    doc["ok"]       = true;
    doc["autoSave"] = irDB.autoSaveEnabled();
    String out; serializeJson(doc, out);
    sendJson(req, 200, out);
}

// ── Backup & Restore handlers ────────────────────────────────

// POST /api/backup
// Creates /ir_database_backup.json from the current live DB.
void WebUI::handleBackupCreate(AsyncWebServerRequest* req) {
    if (!irDB.backup()) {
        sendJson(req, 500, "{\"error\":\"Backup write failed\"}");
        return;
    }
    JsonDocument doc;
    doc["ok"]      = true;
    doc["file"]    = DB_BACKUP_FILE;
    doc["buttons"] = (int)irDB.size();
    String out; serializeJson(doc, out);
    sendJson(req, 200, out);
}

// GET /api/backup
// Downloads the backup file as an attachment.
void WebUI::handleBackupDownload(AsyncWebServerRequest* req) {
    if (!irDB.hasBackup()) {
        sendJson(req, 404, "{\"error\":\"No backup found — POST /api/backup first\"}");
        return;
    }
    // Stream directly from LittleFS — no String copy in RAM
    AsyncWebServerResponse* r = req->beginResponse(
        LittleFS, DB_BACKUP_FILE, "application/json");
    r->addHeader("Content-Disposition",
                 "attachment; filename=\"ir_database_backup.json\"");
    r->addHeader("Access-Control-Allow-Origin", "*");
    req->send(r);
}

// GET /api/backup/status
// Returns metadata: exists, size, button count estimate.
void WebUI::handleBackupStatus(AsyncWebServerRequest* req) {
    JsonDocument doc;
    bool exists = irDB.hasBackup();
    doc["exists"] = exists;
    if (exists) {
        File f = LittleFS.open(DB_BACKUP_FILE, "r");
        if (f) {
            doc["sizeBytes"] = (uint32_t)f.size();
            f.close();
        }
    }
    doc["liveButtons"]  = (int)irDB.size();
    doc["maxButtons"]   = MAX_BUTTONS;
    doc["maxRawButtons"]= MAX_RAW_BUTTONS;
    String out; serializeJson(doc, out);
    sendJson(req, 200, out);
}

// POST /api/restore  (body: raw JSON of ir_database.json format)
// Full pipeline: validate → backup current DB → atomic swap.
void WebUI::handleRestore(AsyncWebServerRequest* req, uint8_t* d, size_t l) {
    // Size guard — reject oversized bodies before any processing
    if (l == 0) {
        sendJson(req, 400, "{\"error\":\"Empty body\"}");
        return;
    }
    if (l > DB_RESTORE_MAX_BYTES) {
        sendJson(req, 413, "{\"error\":\"File too large for restore\"}");
        return;
    }

    String json(reinterpret_cast<const char*>(d), l);

    // Full restore: validate → backup → atomic importJson
    IRDatabase::RestoreResult res = irDB.restore(json);

    JsonDocument doc;
    doc["ok"]       = res.ok;
    doc["accepted"] = res.accepted;
    doc["rejected"] = res.rejected;
    if (!res.error.isEmpty()) doc["note"] = res.error;

    if (res.ok) {
        doc["buttons"] = (int)irDB.size();
        String out; serializeJson(doc, out);
        sendJson(req, 200, out);
    } else {
        String out; serializeJson(doc, out);
        sendJson(req, 400, out);
    }
}

// ── Broadcasts ────────────────────────────────────────────────
void WebUI::broadcastIREvent(const IRButton& btn) {
    JsonDocument doc;
    doc["event"]    = "ir_received";
    doc["protocol"] = protocolName(btn.protocol);
    doc["bits"]     = btn.bits;
    doc["name"]     = btn.name;
    // Include carrier frequency so the UI can display/save it correctly.
    // For decoded protocols this is always IR_DEFAULT_FREQ_KHZ (38).
    // For RAW captures it reflects the actual measured/stored frequency.
    doc["freqKHz"]  = btn.freqKHz;
    char hex[20];
    snprintf(hex, sizeof(hex), "0x%llX", (unsigned long long)btn.code);
    doc["code"] = hex;
    if (btn.protocol==IRProtocol::RAW && !btn.rawData.empty()) {
        JsonArray a = doc["rawData"].to<JsonArray>();
        for (uint16_t v : btn.rawData) a.add(v);
    }
    String msg; serializeJson(doc,msg);
    _pushWsMessage(msg);
}

void WebUI::broadcastMessage(const String& msg) {
    JsonDocument doc; doc["event"]="message"; doc["message"]=msg;
    String out; serializeJson(doc,out);
    _pushWsMessage(out);
}

void WebUI::broadcastOtaProgress(size_t done, size_t total) {
    JsonDocument doc; doc["event"]="ota_progress";
    doc["done"]=(uint32_t)done; doc["total"]=(uint32_t)total;
    doc["percent"]=total>0?(uint8_t)((done*100)/total):0;
    String msg; serializeJson(doc,msg);
    _pushWsMessage(msg);
}

void WebUI::broadcastOtaResult(bool success, const String& message) {
    JsonDocument doc; doc["event"]="ota_result";
    doc["success"]=success; doc["message"]=message;
    String msg; serializeJson(doc,msg);
    _pushWsMessage(msg);
}

void WebUI::broadcastStatus() {
    JsonDocument doc;
    doc["event"]       = "status";
    doc["heap"]        = ESP.getFreeHeap();
    doc["uptime"]      = (uint32_t)(millis()/1000);
    doc["staConnected"]= wifiMgr.staConnected();
    doc["staRSSI"]     = wifiMgr.staRSSI();
    doc["staSSID"]     = wifiMgr.staSSID();
    doc["staStatus"]   = wifiMgr.staStatus();
    doc["staIP"]       = wifiMgr.staIP();
    doc["apActive"]    = wifiMgr.apActive();
    doc["apIP"]        = wifiMgr.apIP();
    doc["ntpSynced"]   = scheduler.ntpSynced();
    doc["time"]        = scheduler.ntpSynced() ? scheduler.currentTimeStr() : "";
    doc["sdMounted"]   = sdMgr.isAvailable();
    doc["sdMacro"]     = sdMgr.isMacroRunning();
    doc["macroRunning"]= macroMgr.isRunning();
    doc["macroName"]   = macroMgr.runningName();
    doc["macroStep"]   = macroMgr.runStep();
    doc["macroTotal"]  = macroMgr.runTotal();
    String msg; serializeJson(doc,msg);
    _pushWsMessage(msg);
}

// ── GPIO handlers ─────────────────────────────────────────────
void WebUI::handleGetGpioPins(AsyncWebServerRequest* req) {
    IrPinConfig pins;
    wifiMgr.loadIrPins(pins);
    JsonDocument doc;
    doc["recvPin"]   = irReceiver.activePin();
    doc["emitCount"] = irTransmitter.activeCount();
    JsonArray ea = doc["emitters"].to<JsonArray>();
    for (uint8_t i = 0; i < IR_MAX_EMITTERS; ++i) {
        JsonObject o = ea.add<JsonObject>();
        o["idx"]     = i;
        o["pin"]     = pins.emitPin[i];
        o["enabled"] = pins.emitEnabled[i];
    }
    String out; serializeJson(doc,out); sendJson(req,200,out);
}

void WebUI::handleSetGpioPins(AsyncWebServerRequest* req, uint8_t* d, size_t l) {
    JsonDocument doc;
    if (deserializeJson(doc,d,l)!=DeserializationError::Ok)
        { sendJson(req,400,"{\"error\":\"JSON parse failed\"}"); return; }

    IrPinConfig pins;
    wifiMgr.loadIrPins(pins);
    IrPinConfig proposed = pins;

    JsonDocument respDoc;
    JsonArray warnings = respDoc["warnings"].to<JsonArray>();
    bool anyError = false;
    bool changed  = false;

    if (doc["recvPin"].is<int>()) {
        uint8_t pin = doc["recvPin"].as<uint8_t>();
        uint8_t excl[IR_MAX_EMITTERS]; uint8_t exclN=0;
        for (uint8_t i=0;i<IR_MAX_EMITTERS;++i)
            if (proposed.emitEnabled[i]) excl[exclN++]=proposed.emitPin[i];
        PinStatus st = validateRxPin(pin, excl, exclN);
        if (st!=PinStatus::OK && st!=PinStatus::OK_RX_ONLY) {
            warnings.add(String("RX GPIO")+pin+" rejected: "+pinStatusMsg(st));
            anyError=true;
        } else if (pin != proposed.recvPin) {
            proposed.recvPin=pin; changed=true;
        }
    }

    if (doc["emitters"].is<JsonArrayConst>()) {
        for (JsonObjectConst o : doc["emitters"].as<JsonArrayConst>()) {
            uint8_t idx = o["idx"] | (uint8_t)255;
            if (idx>=IR_MAX_EMITTERS) continue;
            bool    enabled = o["enabled"] | proposed.emitEnabled[idx];
            uint8_t pin     = o["pin"]     | proposed.emitPin[idx];
            if (enabled) {
                uint8_t excl[IR_MAX_EMITTERS+1]; uint8_t exclN=0;
                excl[exclN++]=proposed.recvPin;
                for (uint8_t j=0;j<IR_MAX_EMITTERS;++j)
                    if (j!=idx && proposed.emitEnabled[j]) excl[exclN++]=proposed.emitPin[j];
                PinStatus st = validateTxPin(pin,excl,exclN);
                if (st!=PinStatus::OK) {
                    warnings.add(String("Emitter[")+idx+"] GPIO"+pin+" rejected: "+pinStatusMsg(st));
                    enabled=false;
                }
            }
            if (pin!=proposed.emitPin[idx]||enabled!=proposed.emitEnabled[idx]) {
                proposed.emitPin[idx]=pin; proposed.emitEnabled[idx]=enabled; changed=true;
            }
        }
        if (doc["emitCount"].is<int>()) {
            uint8_t ec=doc["emitCount"].as<uint8_t>();
            proposed.emitCount=min(ec,(uint8_t)IR_MAX_EMITTERS);
        }
    }

    // Apply all changes together — outside the emitters block so a
    // RX-only change (no "emitters" key) is also committed.
    if (changed && !anyError) {
        pins = proposed;

        // Apply new RX pin to the live receiver
        if (pins.recvPin != irReceiver.activePin()) {
            if (!irReceiver.changePin(pins.recvPin)) {
                warnings.add(String("RX GPIO") + pins.recvPin + " changePin failed at runtime");
            }
        }

        // Reconfigure TX emitters
        irTransmitter.reconfigure(pins);
    }

    if (!wifiMgr.saveIrPins(pins))
        warnings.add("Warning: pin config could not be saved to flash");

    respDoc["ok"]            = !anyError;
    respDoc["activeRecvPin"] = irReceiver.activePin();
    respDoc["activeEmitters"]= irTransmitter.activeCount();
    String out; serializeJson(respDoc,out);
    sendJson(req, anyError?207:200, out);
}

void WebUI::handleGetPinList(AsyncWebServerRequest* req) {
    JsonDocument doc;
    JsonArray pins = doc["pins"].to<JsonArray>();
    struct PinMeta { uint8_t gpio; const char* label; bool txOk; bool rxOk; const char* note; };
    static const PinMeta META[] = {
        {4,  "GPIO4",  true,  true,  "General purpose"},
        {13, "GPIO13", true,  true,  "General purpose"},
        {14, "GPIO14", true,  true,  "Default RX — PWM at boot"},
        {16, "GPIO16", true,  true,  "General purpose"},
        {17, "GPIO17", true,  true,  "General purpose"},
        {18, "GPIO18", true,  true,  "SPI CLK (free if SPI unused)"},
        {19, "GPIO19", true,  true,  "SPI MISO (free if SPI unused)"},
        {21, "GPIO21", true,  true,  "I2C SDA (free if I2C unused)"},
        {22, "GPIO22", true,  true,  "I2C SCL (free if I2C unused)"},
        {23, "GPIO23", true,  true,  "SPI MOSI (free if SPI unused)"},
        {25, "GPIO25", true,  true,  "DAC1 — general purpose"},
        {26, "GPIO26", true,  true,  "DAC2 — general purpose"},
        {27, "GPIO27", true,  true,  "Default TX — general purpose"},
        {32, "GPIO32", true,  true,  "General purpose"},
        {33, "GPIO33", true,  true,  "General purpose"},
        {34, "GPIO34", false, true,  "Input-only — RX only"},
        {35, "GPIO35", false, true,  "Input-only — RX only"},
        {36, "GPIO36", false, true,  "Input-only (SVP) — RX only"},
        {39, "GPIO39", false, true,  "Input-only (SVN) — RX only"},
    };
    uint8_t curRx = irReceiver.activePin();
    for (const auto& m : META) {
        JsonObject o = pins.add<JsonObject>();
        o["gpio"]    = m.gpio;
        o["label"]   = m.label;
        o["txOk"]    = m.txOk;
        o["rxOk"]    = m.rxOk;
        o["note"]    = m.note;
        o["inUseRx"] = (m.gpio == curRx);
        bool inUseTx = false;
        for (uint8_t i=0;i<IR_MAX_EMITTERS;++i)
            if (irTransmitter.emitterPin(i)==m.gpio) { inUseTx=true; break; }
        o["inUseTx"] = inUseTx;
    }
    doc["maxEmitters"]  = IR_MAX_EMITTERS;
    doc["maxReceivers"] = 1;
    String out; serializeJson(doc,out); sendJson(req,200,out);
}

// ============================================================
//  SD Card API Routes
//  All routes return {"error":"SD not available"} gracefully
//  when no SD card is inserted — no crashes, no broken UI.
// ============================================================

// ── Inline helpers ────────────────────────────────────────────
static void sdNotAvail(AsyncWebServerRequest* req) {
    sendJson(req, 503, "{\"error\":\"SD not available\"}");
}

// ── Route Registration ────────────────────────────────────────
// ── Internal LittleFS Macro routes (v2.2.0) ───────────────────
void WebUI::setupMacroRoutes() {
    _server.on("/api/macros", HTTP_GET,
        [this](AsyncWebServerRequest* req) { handleMacroList(req); });
    _server.on("/api/macro", HTTP_GET,
        [this](AsyncWebServerRequest* req) { handleMacroRead(req); });
    POST_BODY("/api/macro",
        [this](AsyncWebServerRequest* req, uint8_t* d, size_t l)
            { handleMacroSave(req, d, l); });
    _server.on("/api/macro/delete", HTTP_GET,
        [this](AsyncWebServerRequest* req) { handleMacroDelete(req); });
    _server.on("/api/macro/run", HTTP_GET,
        [this](AsyncWebServerRequest* req) { handleMacroRun(req); });
    _server.on("/api/macro/abort", HTTP_POST,
        [this](AsyncWebServerRequest* req) { handleMacroAbort(req); });
    _server.on("/api/macro/status", HTTP_GET,
        [this](AsyncWebServerRequest* req) { handleMacroStatus(req); });
}

// GET /api/macros — list all internal macros
void WebUI::handleMacroList(AsyncWebServerRequest* req) {
    auto list = macroMgr.list();
    JsonDocument doc;
    JsonArray arr = doc.to<JsonArray>();
    for (const auto& m : list) {
        JsonObject o = arr.add<JsonObject>();
        o["name"]      = m.name;
        o["label"]     = m.label;
        o["stepCount"] = m.stepCount;
    }
    String out; serializeJson(doc, out);
    sendJson(req, 200, out);
}

// GET /api/macro?name=x — read macro JSON
void WebUI::handleMacroRead(AsyncWebServerRequest* req) {
    if (!req->hasParam("name"))
        { sendJson(req,400,"{\"error\":\"Missing name\"}"); return; }
    String name = req->getParam("name")->value();
    String label;
    std::vector<MacroInternalStep> steps;
    if (!macroMgr.load(name, label, steps))
        { sendJson(req,404,"{\"error\":\"Not found\"}"); return; }
    JsonDocument doc;
    doc["name"] = label;
    JsonArray arr = doc["steps"].to<JsonArray>();
    for (const auto& s : steps) {
        JsonObject o = arr.add<JsonObject>();
        o["buttonId"]     = s.buttonId;
        o["delayAfterMs"] = s.delayAfterMs;
    }
    String out; serializeJson(doc, out);
    sendJson(req, 200, out);
}

// POST /api/macro?name=x  body=JSON — save macro
void WebUI::handleMacroSave(AsyncWebServerRequest* req, uint8_t* d, size_t l) {
    if (!req->hasParam("name"))
        { sendJson(req,400,"{\"error\":\"Missing name param\"}"); return; }
    String name = req->getParam("name")->value();
    String err = macroMgr.save(name, d, l);
    if (!err.isEmpty()) {
        JsonDocument r; r["error"] = err;
        String out; serializeJson(r, out);
        sendJson(req, 400, out);
        return;
    }
    JsonDocument r; r["ok"] = true; r["name"] = name;
    String out; serializeJson(r, out);
    sendJson(req, 200, out);
}

// GET /api/macro/delete?name=x
void WebUI::handleMacroDelete(AsyncWebServerRequest* req) {
    if (!req->hasParam("name"))
        { sendJson(req,400,"{\"error\":\"Missing name\"}"); return; }
    String name = req->getParam("name")->value();
    if (!macroMgr.remove(name))
        { sendJson(req,404,"{\"error\":\"Not found\"}"); return; }
    sendJson(req, 200, "{\"ok\":true}");
}

// GET /api/macro/run?name=x
void WebUI::handleMacroRun(AsyncWebServerRequest* req) {
    if (!req->hasParam("name"))
        { sendJson(req,400,"{\"error\":\"Missing name\"}"); return; }
    if (macroMgr.isRunning())
        { sendJson(req,409,"{\"error\":\"Macro already running\"}"); return; }
    String name = req->getParam("name")->value();
    if (!macroMgr.run(name))
        { sendJson(req,404,"{\"error\":\"Not found or invalid\"}"); return; }
    JsonDocument r;
    r["ok"]   = true; r["name"] = name;
    r["steps"]= macroMgr.runTotal();
    String out; serializeJson(r, out);
    sendJson(req, 200, out);
}

// POST /api/macro/abort
void WebUI::handleMacroAbort(AsyncWebServerRequest* req) {
    macroMgr.abort();
    sendJson(req, 200, "{\"ok\":true}");
}

// GET /api/macro/status
void WebUI::handleMacroStatus(AsyncWebServerRequest* req) {
    JsonDocument doc;
    doc["running"]  = macroMgr.isRunning();
    doc["name"]     = macroMgr.runningName();
    doc["step"]     = macroMgr.runStep();
    doc["total"]    = macroMgr.runTotal();
    String out; serializeJson(doc, out);
    sendJson(req, 200, out);
}

void WebUI::setupSdRoutes() {
    // Status
    _server.on("/api/sd/status", HTTP_GET,
        [this](AsyncWebServerRequest* req) { handleSdStatus(req); });

    // File manager
    _server.on("/api/sd/ls", HTTP_GET,
        [this](AsyncWebServerRequest* req) { handleSdList(req); });

    _server.on("/api/sd/delete", HTTP_GET,
        [this](AsyncWebServerRequest* req) { handleSdDelete(req); });

    POST_BODY("/api/sd/rename",
        ([this](AsyncWebServerRequest* req, uint8_t* d, size_t l) {
            handleSdRename(req, d, l); }));

    POST_BODY("/api/sd/mkdir",
        ([this](AsyncWebServerRequest* req, uint8_t* d, size_t l) {
            handleSdMkdir(req, d, l); }));

    _server.on("/api/sd/download", HTTP_GET,
        [this](AsyncWebServerRequest* req) { handleSdDownload(req); });

    // SD upload (multipart file upload to SD)
    _server.on("/api/sd/upload", HTTP_POST,
        [](AsyncWebServerRequest* req) {
            sendJson(req, 200, "{\"ok\":true}");
        },
        [this](AsyncWebServerRequest* req, const String& fn,
               size_t idx, uint8_t* data, size_t len, bool final) {
            handleSdUpload(req, fn, idx, data, len, final);
        });

    // Log
    _server.on("/api/sd/log", HTTP_GET,
        [this](AsyncWebServerRequest* req) { handleSdLog(req); });

    // OTA from SD
    POST_BODY("/api/sd/ota",
        ([this](AsyncWebServerRequest* req, uint8_t* d, size_t l) {
            handleSdOtaTrigger(req); }));

    // Also accept GET for simple trigger (e.g. curl)
    _server.on("/api/sd/ota", HTTP_GET,
        [this](AsyncWebServerRequest* req) { handleSdOtaTrigger(req); });

    // Backup / Restore
    POST_BODY("/api/sd/backup",
        ([this](AsyncWebServerRequest* req, uint8_t* d, size_t l) {
            handleSdBackup(req, d, l); }));

    POST_BODY("/api/sd/restore",
        ([this](AsyncWebServerRequest* req, uint8_t* d, size_t l) {
            handleSdRestore(req, d, l); }));

    _server.on("/api/sd/backups", HTTP_GET,
        [this](AsyncWebServerRequest* req) { handleSdBackupList(req); });

    // Macros
    _server.on("/api/sd/macros", HTTP_GET,
        [this](AsyncWebServerRequest* req) { handleSdMacroList(req); });

    _server.on("/api/sd/macro/run", HTTP_GET,
        [this](AsyncWebServerRequest* req) { handleSdMacroRun(req); });

    _server.on("/api/sd/macro/status", HTTP_GET,
        [this](AsyncWebServerRequest* req) { handleSdMacroStatus(req); });

    // IR Library
    _server.on("/api/sd/irlibrary", HTTP_GET,
        [this](AsyncWebServerRequest* req) { handleSdIRLibList(req); });

    POST_BODY("/api/sd/irlibrary/export",
        ([this](AsyncWebServerRequest* req, uint8_t* d, size_t l) {
            handleSdIRLibExport(req, d, l); }));

    POST_BODY("/api/sd/irlibrary/import",
        ([this](AsyncWebServerRequest* req, uint8_t* d, size_t l) {
            handleSdIRLibImport(req, d, l); }));

    // Device profiles
    _server.on("/api/sd/devices", HTTP_GET,
        [this](AsyncWebServerRequest* req) { handleSdDeviceList(req); });

    _server.on("/api/sd/device", HTTP_GET,
        [this](AsyncWebServerRequest* req) { handleSdDeviceRead(req); });

    // ── Advanced File Manager routes ──────────────────────────
    POST_BODY("/api/sd/copy",
        ([this](AsyncWebServerRequest* req, uint8_t* d, size_t l) {
            handleSdCopy(req, d, l); }));

    POST_BODY("/api/sd/move",
        ([this](AsyncWebServerRequest* req, uint8_t* d, size_t l) {
            handleSdMove(req, d, l); }));

    _server.on("/api/sd/rmrf", HTTP_GET,
        [this](AsyncWebServerRequest* req) { handleSdDeleteRecursive(req); });

    _server.on("/api/sd/info", HTTP_GET,
        [this](AsyncWebServerRequest* req) { handleSdFileInfo(req); });

    _server.on("/api/sd/read", HTTP_GET,
        [this](AsyncWebServerRequest* req) { handleSdReadText(req); });

    POST_BODY("/api/sd/format",
        ([this](AsyncWebServerRequest* req, uint8_t* d, size_t l) {
            handleSdFormat(req, d, l); }));
}

// ── /api/sd/status ───────────────────────────────────────────
void WebUI::handleSdStatus(AsyncWebServerRequest* req) {
    SdStatus s = sdMgr.status();
    JsonDocument doc;
    doc["mounted"]    = s.mounted;
    doc["cardType"]   = s.cardTypeStr;
    doc["totalKB"]    = (uint32_t)(s.totalBytes / 1024);
    doc["usedKB"]     = (uint32_t)(s.usedBytes  / 1024);
    doc["freeKB"]     = (uint32_t)((s.totalBytes - s.usedBytes) / 1024);
    doc["macroRunning"] = sdMgr.isMacroRunning();
    String out; serializeJson(doc, out);
    sendJson(req, 200, out);
}

// ── /api/sd/ls ────────────────────────────────────────────────
void WebUI::handleSdList(AsyncWebServerRequest* req) {
    if (!sdMgr.isAvailable()) { sdNotAvail(req); return; }
    String path = req->hasParam("path") ? req->getParam("path")->value() : "/";
    auto entries = sdMgr.listDir(path);
    JsonDocument doc;
    doc["path"] = path;
    JsonArray arr = doc["files"].to<JsonArray>();
    for (const auto& e : entries) {
        JsonObject o = arr.add<JsonObject>();
        o["name"]  = e.name;
        o["isDir"] = e.isDir;
        o["size"]  = (uint32_t)e.size;
    }
    String out; serializeJson(doc, out);
    sendJson(req, 200, out);
}

// ── /api/sd/delete ────────────────────────────────────────────
void WebUI::handleSdDelete(AsyncWebServerRequest* req) {
    if (!sdMgr.isAvailable()) { sdNotAvail(req); return; }
    if (!req->hasParam("path")) {
        sendJson(req, 400, "{\"error\":\"Missing path\"}"); return;
    }
    String path = req->getParam("path")->value();
    if (!sdMgr.deleteFile(path)) {
        sendJson(req, 404, "{\"error\":\"Delete failed or not found\"}"); return;
    }
    sendJson(req, 200, "{\"ok\":true}");
}

// ── /api/sd/rename ────────────────────────────────────────────
void WebUI::handleSdRename(AsyncWebServerRequest* req, uint8_t* d, size_t l) {
    if (!sdMgr.isAvailable()) { sdNotAvail(req); return; }
    JsonDocument doc;
    if (deserializeJson(doc, d, l) != DeserializationError::Ok) {
        sendJson(req, 400, "{\"error\":\"JSON parse failed\"}"); return;
    }
    String from = doc["from"] | (const char*)"";
    String to   = doc["to"]   | (const char*)"";
    if (from.isEmpty() || to.isEmpty()) {
        sendJson(req, 400, "{\"error\":\"Missing from/to\"}"); return;
    }
    if (!sdMgr.renameFile(from, to)) {
        sendJson(req, 500, "{\"error\":\"Rename failed\"}"); return;
    }
    sendJson(req, 200, "{\"ok\":true}");
}

// ── /api/sd/mkdir ─────────────────────────────────────────────
void WebUI::handleSdMkdir(AsyncWebServerRequest* req, uint8_t* d, size_t l) {
    if (!sdMgr.isAvailable()) { sdNotAvail(req); return; }
    JsonDocument doc;
    if (deserializeJson(doc, d, l) != DeserializationError::Ok) {
        sendJson(req, 400, "{\"error\":\"JSON parse failed\"}"); return;
    }
    String path = doc["path"] | (const char*)"";
    if (path.isEmpty()) {
        sendJson(req, 400, "{\"error\":\"Missing path\"}"); return;
    }
    if (!sdMgr.makeDir(path)) {
        sendJson(req, 500, "{\"error\":\"mkdir failed\"}"); return;
    }
    sendJson(req, 200, "{\"ok\":true}");
}

// ── /api/sd/download ─────────────────────────────────────────
// Streams SD file using beginResponse(Stream&, ...) which is the
// correct API for ESPAsyncWebServer 3.3.12 (mathieucarbou fork).
// beginChunkedResponse() does NOT exist in this version.
//
// A File is heap-allocated so it outlives the handler stack frame.
// ESPAsyncWebServer streams it asynchronously and calls onDisconnect
// (or the response destructor) when done — we delete the File there.
void WebUI::handleSdDownload(AsyncWebServerRequest* req) {
    if (!sdMgr.isAvailable()) { sdNotAvail(req); return; }
    if (!req->hasParam("path")) {
        sendJson(req, 400, "{\"error\":\"Missing path\"}"); return;
    }
    String path = req->getParam("path")->value();
    if (!sdMgr.exists(path)) {
        sendJson(req, 404, "{\"error\":\"File not found\"}"); return;
    }

    // Heap-allocate File so it stays open after this stack frame exits.
    // ESPAsyncWebServer streams it from the async task; we clean up on disconnect.
    File* fp = new File(SD.open(path.c_str(), FILE_READ));
    if (!fp || !*fp) {
        delete fp;
        sendJson(req, 500, "{\"error\":\"Cannot open file\"}"); return;
    }

    size_t fileSize = fp->size();

    // Determine MIME type
    String mime = "application/octet-stream";
    if      (path.endsWith(".json"))                          mime = "application/json";
    else if (path.endsWith(".html"))                          mime = "text/html";
    else if (path.endsWith(".css"))                           mime = "text/css";
    else if (path.endsWith(".js"))                            mime = "application/javascript";
    else if (path.endsWith(".txt") || path.endsWith(".log")
          || path.endsWith(".csv"))                           mime = "text/plain";

    // Extract filename for Content-Disposition
    String fname = path;
    int slash = fname.lastIndexOf('/');
    if (slash >= 0) fname = fname.substring(slash + 1);

    // beginResponse(Stream&, contentType, size) — correct API for ESPAsyncWebServer 3.x
    // Passes the File by reference; the server reads it asynchronously.
    AsyncWebServerResponse* r = req->beginResponse(*fp, mime, fileSize);
    r->addHeader("Content-Disposition",
                 String("attachment; filename=\"") + fname + "\"");
    r->addHeader("Access-Control-Allow-Origin", "*");

    // Delete the heap File when the request is fully sent or the client disconnects.
    // This is the standard lifetime-management pattern for ESPAsyncWebServer streaming.
    req->onDisconnect([fp]() {
        if (fp) { fp->close(); delete fp; }
    });

    req->send(r);
}

// ── /api/sd/upload ────────────────────────────────────────────
void WebUI::handleSdUpload(AsyncWebServerRequest* req, const String& filename,
                            size_t index, uint8_t* data, size_t len, bool final)
{
    if (!sdMgr.isAvailable()) return;

    // Determine destination path
    String destDir = "/";
    if (req->hasParam("path")) destDir = req->getParam("path")->value();
    if (!destDir.endsWith("/")) destDir += "/";

    // Strip any path from filename — store in destDir only
    String fname = filename;
    int slash = fname.lastIndexOf('/');
    if (slash >= 0) fname = fname.substring(slash + 1);
    String destPath = destDir + fname;

    if (index == 0) {
        // First chunk — open file
        if (!sdMgr.beginUpload(destPath)) {
            Serial.printf(DEBUG_TAG " [SD-Upload] Cannot open: %s\n", destPath.c_str());
            return;
        }
        Serial.printf(DEBUG_TAG " [SD-Upload] Uploading to: %s\n", destPath.c_str());
    }

    if (!sdMgr.writeUploadChunk(data, len)) {
        Serial.println(DEBUG_TAG " [SD-Upload] Write error");
        sdMgr.abortUpload();
        return;
    }

    if (final) {
        sdMgr.endUpload();
        Serial.printf(DEBUG_TAG " [SD-Upload] Done: %s\n", destPath.c_str());
    }
}

// ── /api/sd/log ───────────────────────────────────────────────
void WebUI::handleSdLog(AsyncWebServerRequest* req) {
    if (!sdMgr.isAvailable()) { sdNotAvail(req); return; }
    uint16_t lines = 50;
    if (req->hasParam("lines"))
        lines = (uint16_t)constrain(req->getParam("lines")->value().toInt(), 1, 500);
    String logText = sdMgr.tailLog(lines);
    AsyncWebServerResponse* r = req->beginResponse(200, "text/plain", logText);
    r->addHeader("Access-Control-Allow-Origin", "*");
    req->send(r);
}

// ── /api/sd/ota ───────────────────────────────────────────────
void WebUI::handleSdOtaTrigger(AsyncWebServerRequest* req) {
    if (!sdMgr.isAvailable()) { sdNotAvail(req); return; }
    String target = "firmware";
    if (req->hasParam("target")) target = req->getParam("target")->value();

    if (!sdMgr.otaFileExists(target)) {
        String msg = String("{\"error\":\"OTA file not found on SD: ") +
                     (target == "filesystem" ? SD_OTA_FILESYSTEM : SD_OTA_FIRMWARE) +
                     "\"}";
        sendJson(req, 404, msg); return;
    }

    size_t sz = sdMgr.otaFileSize(target);
    // Send acknowledgement before starting (OTA blocks briefly)
    sendJson(req, 200, String("{\"ok\":true,\"target\":\"") + target +
             "\",\"bytes\":" + String((uint32_t)sz) +
             ",\"note\":\"OTA started from SD — device will reboot\"}");

    // Queue the actual OTA in the restart mechanism —
    // we need the HTTP response to flush first.
    // Use a short delay then trigger from loop via s_restartAt pattern.
    // Actually: trigger directly since response is async and already queued.
    // OtaManager handles the async chunk feeding internally.
    bool ok = sdMgr.triggerOtaFromSD(target);
    // FIX: s_restartAt write must be protected by the same spinlock
    // used in main.cpp loop() — was written unprotected (race condition).
    // Use OTA onEnd callback path instead; finishUpdate() already fires
    // the broadcastOtaResult which triggers the restart via onEnd callback.
    // Direct s_restartAt write removed — restart handled by otaMgr callback.
    (void)ok;
}

// ── /api/sd/backup ────────────────────────────────────────────
void WebUI::handleSdBackup(AsyncWebServerRequest* req, uint8_t* d, size_t l) {
    if (!sdMgr.isAvailable()) { sdNotAvail(req); return; }
    String tag = "manual";
    if (l > 0) {
        JsonDocument doc;
        if (deserializeJson(doc, d, l) == DeserializationError::Ok)
            tag = doc["tag"] | (const char*)"manual";
    }
    // Append timestamp to tag for uniqueness
    tag.replace("/", "_"); tag.replace(" ", "_");
    time_t now = time(nullptr);
    if (now > 1700000000UL) {
        struct tm tmbuf, *t = localtime_r(&now, &tmbuf);
        char ts[20];
        snprintf(ts, sizeof(ts), "_%04d%02d%02d_%02d%02d",
                 t->tm_year+1900, t->tm_mon+1, t->tm_mday,
                 t->tm_hour, t->tm_min);
        tag += ts;
    }
    bool ok = sdMgr.backupToSD(tag);
    if (!ok) { sendJson(req, 500, "{\"error\":\"Backup failed\"}"); return; }
    JsonDocument r;
    r["ok"]  = true;
    r["tag"] = tag;
    String out; serializeJson(r, out);
    sendJson(req, 200, out);
}

// ── /api/sd/restore ───────────────────────────────────────────
void WebUI::handleSdRestore(AsyncWebServerRequest* req, uint8_t* d, size_t l) {
    if (!sdMgr.isAvailable()) { sdNotAvail(req); return; }
    JsonDocument doc;
    if (deserializeJson(doc, d, l) != DeserializationError::Ok) {
        sendJson(req, 400, "{\"error\":\"JSON parse failed\"}"); return;
    }
    String tag = doc["tag"] | (const char*)"";
    if (tag.isEmpty()) {
        sendJson(req, 400, "{\"error\":\"Missing tag\"}"); return;
    }
    bool ok = sdMgr.restoreFromSD(tag);
    if (!ok) { sendJson(req, 500, "{\"error\":\"Restore failed\"}"); return; }
    sendJson(req, 200, "{\"ok\":true,\"note\":\"Restart recommended to reload config\"}");
}

// ── /api/sd/backups ───────────────────────────────────────────
void WebUI::handleSdBackupList(AsyncWebServerRequest* req) {
    if (!sdMgr.isAvailable()) { sdNotAvail(req); return; }
    auto list = sdMgr.listBackups();
    JsonDocument doc;
    JsonArray arr = doc["backups"].to<JsonArray>();
    for (const auto& b : list) arr.add(b);
    String out; serializeJson(doc, out);
    sendJson(req, 200, out);
}

// ── /api/sd/macro/run ─────────────────────────────────────────
void WebUI::handleSdMacroRun(AsyncWebServerRequest* req) {
    if (!sdMgr.isAvailable()) { sdNotAvail(req); return; }
    if (!req->hasParam("file")) {
        sendJson(req, 400, "{\"error\":\"Missing file param\"}"); return;
    }
    if (sdMgr.isMacroRunning()) {
        sendJson(req, 409, "{\"error\":\"Macro already running\"}"); return;
    }
    String fname = req->getParam("file")->value();
    if (!sdMgr.queueMacro(fname)) {
        sendJson(req, 404, "{\"error\":\"Macro not found or invalid\"}"); return;
    }
    sendJson(req, 200, String("{\"ok\":true,\"file\":\"") + fname + "\"}");
}

// ── /api/sd/macro/status ──────────────────────────────────────
void WebUI::handleSdMacroStatus(AsyncWebServerRequest* req) {
    JsonDocument doc;
    doc["running"] = sdMgr.isMacroRunning();
    doc["sdAvailable"] = sdMgr.isAvailable();
    String out; serializeJson(doc, out);
    sendJson(req, 200, out);
}

// ── /api/sd/macros ────────────────────────────────────────────
void WebUI::handleSdMacroList(AsyncWebServerRequest* req) {
    if (!sdMgr.isAvailable()) { sdNotAvail(req); return; }
    auto list = sdMgr.listMacros();
    JsonDocument doc;
    JsonArray arr = doc["macros"].to<JsonArray>();
    for (const auto& m : list) arr.add(m);
    String out; serializeJson(doc, out);
    sendJson(req, 200, out);
}

// ── /api/sd/irlibrary/export ──────────────────────────────────
void WebUI::handleSdIRLibExport(AsyncWebServerRequest* req, uint8_t* d, size_t l) {
    if (!sdMgr.isAvailable()) { sdNotAvail(req); return; }
    String name = "library";
    if (l > 0) {
        JsonDocument doc;
        if (deserializeJson(doc, d, l) == DeserializationError::Ok)
            name = doc["name"] | (const char*)"library";
    }
    name.replace("/", "_"); name.replace(" ", "_");
    if (!sdMgr.exportIRLibrary(name)) {
        sendJson(req, 500, "{\"error\":\"Export failed\"}"); return;
    }
    JsonDocument r;
    r["ok"]      = true;
    r["name"]    = name;
    r["buttons"] = (int)irDB.size();
    String out; serializeJson(r, out);
    sendJson(req, 200, out);
}

// ── /api/sd/irlibrary/import ──────────────────────────────────
void WebUI::handleSdIRLibImport(AsyncWebServerRequest* req, uint8_t* d, size_t l) {
    if (!sdMgr.isAvailable()) { sdNotAvail(req); return; }
    JsonDocument doc;
    if (deserializeJson(doc, d, l) != DeserializationError::Ok) {
        sendJson(req, 400, "{\"error\":\"JSON parse failed\"}"); return;
    }
    String name = doc["name"] | (const char*)"";
    if (name.isEmpty()) {
        sendJson(req, 400, "{\"error\":\"Missing name\"}"); return;
    }
    if (!sdMgr.importIRLibrary(name)) {
        sendJson(req, 404, "{\"error\":\"Library not found or invalid\"}"); return;
    }
    JsonDocument r;
    r["ok"]      = true;
    r["buttons"] = (int)irDB.size();
    String out; serializeJson(r, out);
    sendJson(req, 200, out);
}

// ── /api/sd/irlibrary ─────────────────────────────────────────
void WebUI::handleSdIRLibList(AsyncWebServerRequest* req) {
    if (!sdMgr.isAvailable()) { sdNotAvail(req); return; }
    auto list = sdMgr.listIRLibraries();
    JsonDocument doc;
    JsonArray arr = doc["libraries"].to<JsonArray>();
    for (const auto& f : list) arr.add(f);
    String out; serializeJson(doc, out);
    sendJson(req, 200, out);
}

// ── /api/sd/devices ───────────────────────────────────────────
void WebUI::handleSdDeviceList(AsyncWebServerRequest* req) {
    if (!sdMgr.isAvailable()) { sdNotAvail(req); return; }
    auto list = sdMgr.listDeviceProfiles();
    JsonDocument doc;
    JsonArray arr = doc["devices"].to<JsonArray>();
    for (const auto& d : list) arr.add(d);
    String out; serializeJson(doc, out);
    sendJson(req, 200, out);
}

// ── /api/sd/device ────────────────────────────────────────────
void WebUI::handleSdDeviceRead(AsyncWebServerRequest* req) {
    if (!sdMgr.isAvailable()) { sdNotAvail(req); return; }
    if (!req->hasParam("name")) {
        sendJson(req, 400, "{\"error\":\"Missing name\"}"); return;
    }
    String profile = sdMgr.readDeviceProfile(req->getParam("name")->value());
    if (profile.isEmpty()) {
        sendJson(req, 404, "{\"error\":\"Profile not found\"}"); return;
    }
    AsyncWebServerResponse* r = req->beginResponse(200, "application/json", profile);
    r->addHeader("Access-Control-Allow-Origin", "*");
    req->send(r);
}

// ── /api/sd/copy ──────────────────────────────────────────────
// Body: {"src":"/path/file.txt","dst":"/path/copy.txt"}
void WebUI::handleSdCopy(AsyncWebServerRequest* req, uint8_t* d, size_t l) {
    if (!sdMgr.isAvailable()) { sdNotAvail(req); return; }
    JsonDocument doc;
    if (deserializeJson(doc, d, l) != DeserializationError::Ok) {
        sendJson(req, 400, "{\"error\":\"JSON parse failed\"}"); return;
    }
    String src = doc["src"] | (const char*)"";
    String dst = doc["dst"] | (const char*)"";
    if (src.isEmpty() || dst.isEmpty()) {
        sendJson(req, 400, "{\"error\":\"Missing src/dst\"}"); return;
    }
    if (!sdMgr.exists(src)) {
        sendJson(req, 404, "{\"error\":\"Source not found\"}"); return;
    }
    if (!sdMgr.copyFileSd(src, dst)) {
        sendJson(req, 500, "{\"error\":\"Copy failed\"}"); return;
    }
    sendJson(req, 200, "{\"ok\":true}");
}

// ── /api/sd/move ──────────────────────────────────────────────
// Body: {"src":"/path/file.txt","dst":"/other/file.txt"}
void WebUI::handleSdMove(AsyncWebServerRequest* req, uint8_t* d, size_t l) {
    if (!sdMgr.isAvailable()) { sdNotAvail(req); return; }
    JsonDocument doc;
    if (deserializeJson(doc, d, l) != DeserializationError::Ok) {
        sendJson(req, 400, "{\"error\":\"JSON parse failed\"}"); return;
    }
    String src = doc["src"] | (const char*)"";
    String dst = doc["dst"] | (const char*)"";
    if (src.isEmpty() || dst.isEmpty()) {
        sendJson(req, 400, "{\"error\":\"Missing src/dst\"}"); return;
    }
    if (!sdMgr.exists(src)) {
        sendJson(req, 404, "{\"error\":\"Source not found\"}"); return;
    }
    if (!sdMgr.moveFile(src, dst)) {
        sendJson(req, 500, "{\"error\":\"Move failed\"}"); return;
    }
    sendJson(req, 200, "{\"ok\":true}");
}

// ── /api/sd/rmrf ──────────────────────────────────────────────
// ?path=/dir  — deletes file or entire directory tree
void WebUI::handleSdDeleteRecursive(AsyncWebServerRequest* req) {
    if (!sdMgr.isAvailable()) { sdNotAvail(req); return; }
    if (!req->hasParam("path")) {
        sendJson(req, 400, "{\"error\":\"Missing path\"}"); return;
    }
    String path = req->getParam("path")->value();
    // Safety: refuse to delete root
    if (path == "/" || path.isEmpty()) {
        sendJson(req, 400, "{\"error\":\"Cannot delete root directory\"}"); return;
    }
    if (!sdMgr.exists(path)) {
        sendJson(req, 404, "{\"error\":\"Path not found\"}"); return;
    }
    if (!sdMgr.deleteRecursive(path)) {
        sendJson(req, 500, "{\"error\":\"Delete failed\"}"); return;
    }
    sendJson(req, 200, "{\"ok\":true}");
}

// ── /api/sd/info ──────────────────────────────────────────────
// ?path=/file  — returns metadata (size, modTime, isDir)
void WebUI::handleSdFileInfo(AsyncWebServerRequest* req) {
    if (!sdMgr.isAvailable()) { sdNotAvail(req); return; }
    if (!req->hasParam("path")) {
        sendJson(req, 400, "{\"error\":\"Missing path\"}"); return;
    }
    String path = req->getParam("path")->value();
    if (!sdMgr.exists(path)) {
        sendJson(req, 404, "{\"error\":\"Not found\"}"); return;
    }
    SdFileEntry info = sdMgr.getFileInfo(path);
    JsonDocument doc;
    doc["name"]     = info.name;
    doc["path"]     = path;
    doc["isDir"]    = info.isDir;
    doc["size"]     = (uint32_t)info.size;
    doc["modTime"]  = (uint32_t)info.modTime;
    // Format modTime as human-readable if valid (FAT32 epoch starts 1980)
    if (info.modTime > 315532800UL) {  // > 1980-01-01
        struct tm tmbuf;
        time_t t = (time_t)info.modTime;
        localtime_r(&t, &tmbuf);
        char tbuf[24];
        snprintf(tbuf, sizeof(tbuf), "%04d-%02d-%02d %02d:%02d",
                 tmbuf.tm_year+1900, tmbuf.tm_mon+1, tmbuf.tm_mday,
                 tmbuf.tm_hour, tmbuf.tm_min);
        doc["modTimeStr"] = tbuf;
    } else {
        doc["modTimeStr"] = "";
    }
    String out; serializeJson(doc, out);
    sendJson(req, 200, out);
}

// ── /api/sd/read ──────────────────────────────────────────────
// ?path=/file[&max=8192]  — read text file for preview (max 8 KB)
// Only allows text-safe extensions to prevent binary garbage in UI.
void WebUI::handleSdReadText(AsyncWebServerRequest* req) {
    if (!sdMgr.isAvailable()) { sdNotAvail(req); return; }
    if (!req->hasParam("path")) {
        sendJson(req, 400, "{\"error\":\"Missing path\"}"); return;
    }
    String path = req->getParam("path")->value();

    // Whitelist: only readable text extensions
    static const char* READABLE[] = {
        ".txt", ".log", ".json", ".csv", ".cfg", ".ini",
        ".md",  ".htm", ".html", ".xml", ".yaml", ".yml",
        ".sh",  ".py",  ".js",   ".css", ".conf", nullptr
    };
    bool allowed = false;
    String lower = path; lower.toLowerCase();
    for (const char** ext = READABLE; *ext; ++ext) {
        if (lower.endsWith(*ext)) { allowed = true; break; }
    }
    if (!allowed) {
        sendJson(req, 415, "{\"error\":\"File type not previewable\"}"); return;
    }
    if (!sdMgr.exists(path)) {
        sendJson(req, 404, "{\"error\":\"File not found\"}"); return;
    }

    size_t maxBytes = 8192;
    if (req->hasParam("max")) {
        int m = req->getParam("max")->value().toInt();
        if (m > 0 && m <= 32768) maxBytes = (size_t)m;
    }

    String content = sdMgr.readTextFile(path, maxBytes);
    JsonDocument doc;
    doc["path"]    = path;
    doc["content"] = content;
    doc["size"]    = (uint32_t)sdMgr.getFileInfo(path).size;
    String out; serializeJson(doc, out);
    sendJson(req, 200, out);
}

// ── /api/sd/format ────────────────────────────────────────────
// Body: {"confirm":"FORMAT_SD_CARD"}  — must include exact passphrase
void WebUI::handleSdFormat(AsyncWebServerRequest* req, uint8_t* d, size_t l) {
    if (!sdMgr.isAvailable()) { sdNotAvail(req); return; }
    JsonDocument doc;
    if (deserializeJson(doc, d, l) != DeserializationError::Ok) {
        sendJson(req, 400, "{\"error\":\"JSON parse failed\"}"); return;
    }
    String confirm = doc["confirm"] | (const char*)"";
    // Require exact passphrase to prevent accidental format
    if (confirm != "FORMAT_SD_CARD") {
        sendJson(req, 400, "{\"error\":\"Missing confirmation. Send confirm:\\\"FORMAT_SD_CARD\\\"\"}"); return;
    }
    Serial.println(DEBUG_TAG " [SD] Format triggered by user via Web UI");
    bool ok = sdMgr.formatCard();
    if (!ok) {
        sendJson(req, 500,
            "{\"error\":\"Format not supported in this firmware build. "
            "Use SD Card Formatter (https://www.sdcard.org/downloads/formatter/) on a PC.\"}");
        return;
    }
    sendJson(req, 200, "{\"ok\":true,\"note\":\"Card formatted and remounted\"}");
}
